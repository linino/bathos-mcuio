## Kconfig
```kconfig
mainmenu "BaThos configuration"

config HAS_MEMORY_MODE
	bool

choice
	prompt "Architecture to build for"

config ARCH_ATMEGA
	bool "AtMega -- Arduino-like"
	help
	  This

config ARCH_ARM
        bool "ARM -- Cortex-M based"
	help
	  Build for ARM based machines

# For xtensa, we only build a relocatable bathos.o to be linked to user's code
# and sdk libraries
config ARCH_XTENSA
       bool "XTENSA -- a configurable processor"
       select HAS_MEMORY_MODE

config ARCH_UNIX
	bool "Unix -- run in a process"
	select HAVE_UART
	select HAVE_ARCH_FIND_DEV
	help
	  Build

endchoice

config ARCH
       string
       default "atmega" if ARCH_ATMEGA
       default "versatile" if ARCH_VERSATILE
       default "unix" if ARCH_UNIX
       default "arm" if ARCH_ARM
       default "xtensa" if ARCH_XTENSA


config CROSS_COMPILE
       string "Cross compiler prefix"
       default "arm-none-eabi-" if ARCH_ARM
       default "avr-" if ARCH_ATMEGA
       default "xtensa-lx106-elf-" if ARCH_XTENSA
       default ""

config INTERRUPT_EVENTS
       bool
       default y if ARCH_ARM
       default n

config ISRS_IN_RAM
       bool
       default n

config PIPE_ASYNC_INTERFACE
       bool "Async interface for pipes"
       default y if ARCH_ARM
       default y if ARCH_XTENSA
       default n

config HAVE_RELOCATE_INTERRUPT_TABLE
       bool
       default n

config RELOCATE_VECTORS_TABLE
       bool "Do relocation of vectors table to RAM (data section)"
       depends on HAVE_RELOCATE_INTERRUPT_TABLE
       help
         This allows redirection of low level interrupt handlers, say no
	 if unsure.
       default n

config BATHOS_NORDERS_LOG
       int "Logarithm of allocator's number of orders"
       help
	This sets the logatithm of the allocator's number of orders (see
	lib/allocator.c for more information on the allocator)
       default 3

config BATHOS_ALLOCATOR_MEM_SIZE
       int "Size of memory managed by the allocator"
       help
        This sets the amount of memory managed by the bathos allocator
       default 65536 if ARCH_UNIX
       default 1024

choice
	prompt "Memory mode"

config MMODE_RAM
	bool "Build for RAM-based execution" if HAS_MEMORY_MODE
	help
	  Selecting this options, the code will use RAM addresses,
	  and must be programmed to the device with tools/program (prog-ram).
	  At power-off time the program is lost.

config MMODE_FLASH
	bool "Build for flash-based execution" if HAS_MEMORY_MODE
	help
	  Selecting this options, the code will use flash addresses for code,
	  and must be programmed to the device with tools/progrom (prog-rom).
	  Bathos.bin will be persistent in the device.

endchoice

config MEMORY_MODE
       string
       default "-ram" if MMODE_RAM
       default "-flash" if MMODE_FLASH
       default ""

if ARCH_ATMEGA
   source "arch-atmega/Kconfig"
endif

if ARCH_ARM
   source "arch-arm/Kconfig"
endif

if ARCH_XTENSA
   source "arch-xtensa/Kconfig"
endif

   source "drivers/Kconfig"

config HAVE_IRQ_CONTROLLER
       bool
       default y if ARCH_ARM
       default n

config HAVE_GPIOS
       bool
       default y if ARCH_ATMEGA
       default n

config HAVE_GPIO_TO_AF
       bool
       default n

config HAVE_GPIO_EVENTS
       bool
       default y if ARCH_ATMEGA
       default n

config HAVE_ADCS
       bool
       default y if ARCH_ATMEGA
       default n

config HAVE_PWMS
       bool
       default y if ARCH_ATMEGA
       default n

config GPIO_PORTS_WIDTH
       int
       default 8 if ARCH_ATMEGA

config HAVE_USB_GENERIC_STACK
       bool

config HAVE_UART
       bool

config HAVE_USB_UART
       bool

config HAVE_SPI
       bool

config HAVE_ARCH_FIND_DEV
       bool

choice
	prompt "Bathos console"

config CONSOLE_DEBUG_BITBANG
       bool "Console on debug bitbang"
       depends on DEBUG_BITBANG
       help
         This option selects the debug bitbang console as the console device.

if HAVE_UART

config CONSOLE_UART
       bool "Console on UART"
       help
         This option selects a UART as the console device

endif

config CONSOLE_NULL
       bool "Null console"
       help
	 Select this when you don't want any console

endchoice

config EARLY_CONSOLE
       bool "Setup an early console"

choice
	prompt "Bathos stdin"

config STDIN_CONSOLE
       bool "Stdin from console"
       help
         Take standard input from selected console

if HAVE_UART

config STDIN_UART
       bool "Stdin from UART"
       depends on HAVE_UART
       help
	 Get standard input from uart

endif

if HAVE_USB_UART

config STDIN_USB_UART
       bool "Stdin from USB-UART"
       depends on HAVE_USB_UART
       help
         Get standard input from usb-uart device

endif

endchoice


choice
	prompt "Bathos stdout"

config STDOUT_CONSOLE
       bool "Stdout to console"
       help
         Send stdandard output to selected console

if HAVE_UART

config STDOUT_UART
       bool "Stdout to UART"
       depends on HAVE_UART
       help
         Send standard output from uart

endif

if HAVE_USB_UART

config STDOUT_USB_UART
       bool "Stdout to USB-UART"
       depends on HAVE_USB_UART
       help
         Send standard output to usb-uart device

endif

endchoice


config HZ
       int "Number of timer ticks in a second"
       default 250 if ARCH_ATMEGA
       default 100 if ARCH_ARM
       default 62500 if MACH_VERSATILE
       default 128 if MACH_NRF51822

config HAVE_LWIP
       bool


   source "tasks/Kconfig"

   source "mcuio/Kconfig"

   source "lininoio/Kconfig"
```

## arch-atmega/Kconfig
```kconfig
config HAVE_USB
       bool

config MACH_ATMEGA8
       bool

config MACH_ATMEGA32U4
       bool
       select HAVE_USB

config MACH_ATMEGA328P
       bool

choice
	prompt "Target board for bathos"

config BOARD_ARDUINOYUN
	prompt "Build for Arduino Yun"
	select MACH_ATMEGA32U4
	bool

config BOARD_LININOONE
	prompt "Build for Linino One"
	bool

config BOARD_ANY_ATMEGA32U4
       bool
        prompt "Build for no specific atmega32u4 board"
	select MACH_ATMEGA32U4


endchoice

config MACH
       string
       default "atmega8" if MACH_ATMEGA8
       default "atmega32u4" if MACH_ATMEGA32U4
       default "atmega328p" if MACH_ATMEGA328P

config BOARD
       string
       default "yun" if BOARD_YUN
       default "any" if BOARD_ANY_ATMEGA32U4
       default "lininoone" if BOARD_LININOONE

config THOS_QUARTZ
       int "Oscillator frequency"
       default 16000000

config ATMEGA_USB_UART
       bool "Atmega Usb-uart driver"
       select HAVE_USB_UART
       depends on HAVE_USB
       help
         Add an UART over USB driver for the atmega

config ATMEGA_UART
       bool "Atmega UART driver"
       select HAVE_UART
       help
         Add an UART driver for the atmega

config ATMEGA_SPI
       bool "Atmega SPI driver"
       select HAVE_SPI
       help
         Add a SPI driver for the atmega

config CONSOLE
       string
       default "avr-uart" if CONSOLE_UART
       default "usb-uart" if CONSOLE_USB_UART

config STDIN
       string
       default CONSOLE if STDIN_CONSOLE
       default "avr-uart" if STDIN_UART
       default "usb-uart" if STDIN_USB_UART

config STDOUT
       string
       default CONSOLE if STDOUT_CONSOLE
       default "avr-uart" if STDOUT_UART
       default "usb-uart" if STDOUT_USB_UART

config COPY_STDOUT_TO_CONSOLE
       bool "Copy stdout to console"
       depends on !STDOUT_CONSOLE
       help
         Copy standard output to console

config SMALLSIZE
	bool "Shrink and optimize for size"
	help
	  Remove verbose or useless code, to minimize size in flash"

config ADD_EXTERNAL_BOOTLOADER
       bool "Add external bootloader"
       help
         Add pre-compiled bootloader (hex format) to final image

config EXTERNAL_BOOTLOADER_PATH
       string "External bootloader path"
       depends on ADD_EXTERNAL_BOOTLOADER
       default "Caterina-Yun.hex" if BOARD_ARDUINOYUN
       default "Caterina-LininoOne.hex" if BOARD_LININOONE
       help
         Path of hex file containing external bootloader (placed in top 4k of
	 ATMEGA flash).

config RUN_BOOTLOADER_ON_1200_BPS
       bool "Run bootloader when 1200 bps is set"
       depends on USB_UART
	help
	  Die and run bootloader when a 1200 baud setting is detected
	  on the usb-uart port. This is required for compatibility with
	  Arduino fw updater.
```

## arch-xtensa/Kconfig
```kconfig
choice
	prompt "SOC to build for"

config MACH_EAGLE
       bool "ESP8266 eagle SOC"
       select ESP8266_DRIVERS
       select HAVE_UART
       select INTERRUPT_EVENTS
       select HAVE_IRQ_CONTROLLER
       select ISRS_IN_RAM
       select HAVE_LWIP
       select HAVE_GPIOS
       select HAVE_GPIO_TO_AF
       select HAVE_GPIO_EVENTS
       help
	"Build for the esp8266 chip"

endchoice

config ENABLE_TCP_SERVER_DEV
       bool "Enable tcp server device"
       default true if ARCH_XTENSA
       default false
       help
	"Say yes to enable a device which can be used to implement a tcp server"

config NR_INTERRUPTS
       int
       # "Virtual" IRQs, one line per interrupt cause.
       # For instance SPI IRQs are actually shared in hw, we setup and
       # interrupt event for each spi port
       default 32 if MACH_EAGLE


config MACH
       string
       default "eagle" if MACH_EAGLE


choice
	prompt "Target board for bathos"

config BOARD_STAR_8266
       bool "Arduino STAR board"
       help
	"Build for a STAR board"

config BOARD_MODULINO_8266
       bool "Modulino board (8266 soc)"
       help
	"Build for a MODULINO board"

config BOARD_PRIMO_MINI_8266
       bool "Primo mini board (8266 soc)"
       help
        "Build for a PRIMO MINI board"

endchoice

config BOARD
       default "star" if BOARD_STAR_8266
       default "modulino-8266" if BOARD_MODULINO_8266
       default "primo-mini" if BOARD_PRIMO_MINI_8266

config ESP8266_SERIAL_RX0_FIFO_INT_THRESHOLD
       int "Rx fifo full interrupt threshold, UART0"
       default 16 if MCUIO && MCUIO_PIPE_INPUT_PATH=uart0
       default 1

config ESP8266_SERIAL_RX1_FIFO_INT_THRESHOLD
       int "Rx fifo full interrupt threshold, UART1"
       default 16 if MCUIO && MCUIO_PIPE_INPUT_PATH=uart1
       default 1

config ESP8266_WIFI_DISABLE_AUTO_CONFIG
       bool "Disable automatic wlan configuration for the esp8266"
       default n
       help
         "Disable automatic wlan configuration (dhcp & wlan connection)"
```

## drivers/Kconfig
```kconfig
menu "Drivers configuration"

config DEBUG_BITBANG
       bool "Debug bitbang driver"
       default n
       help
         Add a debug bitbang driver

if DEBUG_BITBANG

config BB_CLOCK_GPIO
       int "Bitbang driver clock gpio number"
       help
	 Guess what

config BB_DATA_GPIO
       int "Bitbang driver data gpio number"
       help
         Guess what

config CONSOLE
       string
       default "debug-bitbang" if CONSOLE_DEBUG_BITBANG

endif

config FREESCALE_DRIVERS
       bool

config STM32F4X_DRIVERS
       bool

config ESP8266_DRIVERS
       bool

config DEFAULT_ESP8266_STATION_HOSTNAME
       depends on ESP8266_DRIVERS
       string "Wifi station hostname"
       default "lininoIO"

config DEFAULT_ESP8266_ESSID
       depends on ESP8266_DRIVERS
       string "Wifi essid"
       default "my-network"

config DEFAULT_ESP8266_PASSWD
       depends on ESP8266_DRIVERS
       string "Wifi password"
       default "12345678"

config AMBA_DRIVERS
       bool

config USB_CONFIG_FILE
       string "Usb configuration file"
       default "configs/freedog_usb_config" if KL25Z_BOARD_FREEDOG

config NRF5X_DRIVERS
       bool

config LININOIO_DRIVERS
       bool

config UNIX_ETH_DRIVER
       depends on PIPE_ASYNC_INTERFACE && ARCH_UNIX

config BP_SPIM_DRIVER
       tristate "Bus pirate spi master driver"
       depends on PIPE_ASYNC_INTERFACE && ARCH_UNIX

endmenu
```

## lininoio/Kconfig
```kconfig
menu "LININOIO protocol"

config TASK_LININOIO
       prompt "Lininoio protocol implementation"
       depends on PIPE_ASYNC_INTERFACE
       select LININOIO_DRIVERS
       bool
       help
	 Enable LININOIO protocol implementation. This is a transport level
	 protocol, typically used on network devices. It can multiplex
	 multiple mcuio connections, binary data channels and more stuff.

config LININOIO_PIPE_PATH
       prompt "Path of input pipe for lininoio protocol"
       depends on TASK_LININOIO
       string
       default "wlan0" if ARCH=xtensa
       default "eth0" if ARCH=unix
       help
         Path of I/O path for lininoIO (must have an async interface)

config LININOIO_SLAVE_NAME
       prompt "Name of lininoio slave node"
       depends on TASK_LININOIO
       string
       default "lininoio-slave"
       help
         Name of lininoio slave node"

config LININOIO_RX_BUFFERS
       prompt "Number of lininoio outstanding rx buffers"
       depends on TASK_LININOIO
       int
       default 2
       help
	 Number of buffers in rx queue

config LININOIO_EXT_PACKAGE
       prompt "Path of lininoio userspace source package"
       depends on TASK_LININOIO
       string
       default "UNKNOWN-LININOIO-PATH"
       help
         Path of lininoio userspace source package"

endmenu
```
