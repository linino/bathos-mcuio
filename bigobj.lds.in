#include <generated/autoconf.h>

SECTIONS
{
	.rodata : {
		*(.rodata);
		*(.rodata.str1.1);
		. = ALIGN(8);
		romcall_begin = .;
		romcall_end = .;
		. += 8;
		initcall_begin = .;
		*(.init1);
		*(.init2);
		*(.init3);
		*(.init4);
		*(.init5);
		*(.init6);
		*(.init7);
		*(.init8);
		initcall_end = .;
	}
	.data : {
		*(.data);
		. = ALIGN(8);
		bathos_devices_start = .;
		*(.bathos_devices);
		bathos_devices_end = .;
		. = ALIGN(64);
		__task_begin = .;
		*(.task);
		__task_end = .;
		. = ALIGN(32);
		cmdline_items_start = .;
		*(.cmdline_items);
		cmdline_items_end = .;
		. = ALIGN(32);
	}
	.text : {
		. = ALIGN(2);
		events_start = .;
		*(.events)
		events_end = .;
#ifndef CONFIG_ISRS_IN_RAM
		default_hl_handlers_start = .;
		*(.default_hl_handlers);
		default_hl_handlers_end = .;
		default_ll_handlers_start = .;
		*(.default_ll_handlers);
		default_ll_handlers_end = .;
#endif
		interrupt_events_start = .;
		*(.interrupt_events);
		interrupt_events_end = .;
		cmds_start = .;
		*(.shell_cmds)
		cmds_end = .;
		mcuio_functions_start = .;
		*(.mcuio_functions);
		mcuio_functions_end = .;
		lininoio_channels_start = .;
		*(.lininoio_channels);
		lininoio_channels_end = .;

		INCLUDE events.lds
	}
}

PROVIDE(__printf = pp_printf);
PROVIDE(__sprintf = pp_sprintf);
PROVIDE(__vprintf = pp_sprintf);
PROVIDE(__vsprintf = pp_vsprintf);
PROVIDE(__pipe_printf = pipe_pp_printf);
